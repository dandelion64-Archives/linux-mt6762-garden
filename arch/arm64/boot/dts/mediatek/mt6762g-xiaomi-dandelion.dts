// SPDX-License-Identifier: (GPL-2.0 OR MIT)
/*
 * Device Tree Source for Xiaomi Redmi 9A (dandelion)
 *
 * Copyright (c) 2023 Arseniy Velikanov <adomerlee@gmail.com>
 * Copyright (C) 2023 Brandon Boese
 */

/dts-v1/;

#include "mt6765-xiaomi-garden-common.dtsi"

/ {
    model = "Xiaomi Redmi 9A";
    compatible = "xiaomi,dandelion", "mediatek,mt6762", "mediatek,mt6765";
};
